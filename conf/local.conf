## conf/local.conf
```bitbake
# Default machine
MACHINE ??= 'imx6qenuc'

# Default distro
DISTRO ?= 'fsl-imx-fb'

# The package manager
PACKAGE_CLASSES ?= "package_ipk"

# Extra image features
EXTRA_IMAGE_FEATURES ?= "debug-tweaks"

# Default uboot configuration
UBOOT_CONFIG="sd"

# Extra tools for building
USER_CLASSES ?= "buildstats image-mklibs image-prelink"

PATCHRESOLVE = "noop"

# Stop conditions if disk is almost full
BB_DISKMON_DIRS = "\
    STOPTASKS,${TMPDIR},1G,100K \
    STOPTASKS,${DL_DIR},1G,100K \
    STOPTASKS,${SSTATE_DIR},1G,100K \
    STOPTASKS,/tmp,100M,100K \
    ABORT,${TMPDIR},100M,1K \
    ABORT,${DL_DIR},100M,1K \
    ABORT,${SSTATE_DIR},100M,1K \
    ABORT,/tmp,10M,1K"

# Qemu parameters
PACKAGECONFIG_append_pn-qemu-native = " sdl"
PACKAGECONFIG_append_pn-nativesdk-qemu = " sdl"
CONF_VERSION = "1"

# Location of shared cache can be used by multiple builds
SSTATE_DIR ?= "${BSPDIR}/cache"

# Location of downloads can be used by multiple builds
DL_DIR ?= "${BSPDIR}/downloads"

# Accept user agreements by default
ACCEPT_FSL_EULA = "1"

# Remove files in deploy/images/*/*
RM_OLD_IMAGE = "1"

# Disable check_uris
CONNECTIVITY_CHECK_URIS = ""
```
